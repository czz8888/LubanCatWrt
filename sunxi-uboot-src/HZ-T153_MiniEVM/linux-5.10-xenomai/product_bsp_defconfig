## sunxi-uboot-src/u-boot-2023/bsp/configs/sun8iw22p1_defconfig
```kconfig
CONFIG_ARM=y
CONFIG_ARM_SMCCC=y
CONFIG_ARCH_SUNXI_ARM=y
CONFIG_TEXT_BASE=0x42A00000
CONFIG_SYS_MALLOC_LEN=0x1000000
CONFIG_HAS_CUSTOM_SYS_INIT_SP_ADDR=y
CONFIG_CUSTOM_SYS_INIT_SP_ADDR=0x48000
CONFIG_DEFAULT_DEVICE_TREE="uboot-board"
CONFIG_MACH_SUN8IW22=y
# CONFIG_VIDEO_SUNXI is not set
CONFIG_SYS_TEXT_BASE=0x42A00000
CONFIG_SUNXI_EXTERN_SECURE_MM_LAYOUT=y
CONFIG_SUNXI_BOOT_PARAM=y
CONFIG_SUNXI_FDT_ADDR=0x42C00000
CONFIG_SUNXI_FPGA_PLATFORM=y
# CONFIG_LOGF_MODULE is not set
# CONFIG_LOGF_LEVEL is not set
# CONFIG_LOGF_DEVNAME is not set
CONFIG_SYS_CUSTOM_LDSCRIPT=y
CONFIG_SYS_LDSCRIPT="bsp/arch/arm/mach-sunxi/u-boot.lds"
CONFIG_ANDROID_BOOT_IMAGE=y
CONFIG_LOG=y
CONFIG_LOG_MAX_LEVEL=9
# CONFIG_LOG_CONSOLE is not set
CONFIG_BOARD_EARLY_INIT_F=y
CONFIG_SYS_MAXARGS=64
CONFIG_SYS_BOOTM_LEN=0x2000000
# CONFIG_ENV_IS_IN_FAT is not set
# CONFIG_NET is not set
CONFIG_CLK_CCF=y
CONFIG_CLK_COMPOSITE_CCF=y
# CONFIG_CLK_SUNXI is not set
CONFIG_MMC_BROKEN_CD=y
# CONFIG_MMC_SUNXI is not set
CONFIG_PINCONF=y
CONFIG_DM_PMIC=y
CONFIG_PMIC_AXP=y
# CONFIG_WDT_SUNXI is not set
CONFIG_GETOPT=y
# CONFIG_TOOLS_LIBCRYPTO is not set
CONFIG_AW_PINCTRL_V3=y
CONFIG_AW_GPIO=y
CONFIG_AW_GPIO_V3=y
# CONFIG_AW_WDT is not set
CONFIG_SUNXI_GPADC=y
```

## sunxi-uboot-src/u-boot-2023/bsp/configs/sun8iw22p1_mr153_defconfig
```kconfig
CONFIG_ARM=y
CONFIG_ARM_SMCCC=y
CONFIG_ARCH_SUNXI_ARM=y
CONFIG_TEXT_BASE=0x43500000
CONFIG_SYS_MALLOC_LEN=0x2000000
CONFIG_HAS_CUSTOM_SYS_INIT_SP_ADDR=y
CONFIG_CUSTOM_SYS_INIT_SP_ADDR=0x48000
CONFIG_ENV_SIZE=0x20000
CONFIG_DEFAULT_DEVICE_TREE="uboot-board"
CONFIG_SUNXI_SECURE_BOOT=y
CONFIG_MACH_SUN8IW22=y
# CONFIG_VIDEO_SUNXI is not set
CONFIG_SUNXI_FDT_ADDR=0x42000000
CONFIG_SYS_CUSTOM_LDSCRIPT=y
CONFIG_SYS_LDSCRIPT="bsp/arch/arm/mach-sunxi/u-boot.lds"
CONFIG_ANDROID_BOOT_IMAGE=y
CONFIG_PREBOOT=""
CONFIG_LOGLEVEL=6
# CONFIG_SYS_DEVICE_NULLDEV is not set
# CONFIG_LOG_CONSOLE is not set
CONFIG_BOARD_EARLY_INIT_F=y
CONFIG_SYS_MAXARGS=64
CONFIG_SYS_BOOTM_LEN=0x2000000
# CONFIG_CMD_EXPORTENV is not set
# CONFIG_CMD_IMPORTENV is not set
# CONFIG_CMD_EDITENV is not set
CONFIG_CMD_ADC=y
CONFIG_CMD_GPIO=y
CONFIG_CMD_I2C=y
# CONFIG_CMD_SF is not set
CONFIG_CMD_PMIC=y
CONFIG_CMD_REGULATOR=y
CONFIG_CMD_LOG=y
# CONFIG_ENV_IS_IN_FAT is not set
# CONFIG_NET is not set
CONFIG_CLK_CCF=y
CONFIG_CLK_COMPOSITE_CCF=y
# CONFIG_CLK_SUNXI is not set
CONFIG_DM_HASH=y
CONFIG_DM_MOD_EXP=y
CONFIG_DMA=y
CONFIG_DMA_CHANNELS=y
CONFIG_MMC_BROKEN_CD=y
# CONFIG_MMC_SUNXI is not set
CONFIG_MTD=y
CONFIG_DM_MTD=y
CONFIG_SPI_FLASH_ATMEL=y
CONFIG_SPI_FLASH_EON=y
CONFIG_SPI_FLASH_GIGADEVICE=y
CONFIG_SPI_FLASH_ISSI=y
CONFIG_SPI_FLASH_MACRONIX=y
CONFIG_SPI_FLASH_SPANSION=y
CONFIG_SPI_FLASH_STMICRO=y
CONFIG_SPI_FLASH_SST=y
CONFIG_SPI_FLASH_WINBOND=y
CONFIG_SPI_FLASH_XMC=y
CONFIG_SPI_FLASH_XTX=y
CONFIG_SPI_FLASH_PUYA=y
CONFIG_SPI_FLASH_FM=y
CONFIG_SPI_FLASH_BOYA=y
CONFIG_SPI_FLASH_ADESTO=y
CONFIG_SPI_FLASH_ZETTA=y
CONFIG_SPI_FLASH_GFX=y
# CONFIG_SPI_FLASH_USE_4K_SECTORS is not set
CONFIG_SPI_FLASH_MTD=y
CONFIG_PINCONF=y
CONFIG_DM_PMIC=y
CONFIG_PMIC_AXP=y
CONFIG_REGULATOR_AXP=y
CONFIG_DM_PWM=y
CONFIG_SOUND=y
CONFIG_SPI=y
CONFIG_DM_USB_GADGET=y
CONFIG_USB_EHCI_HCD=y
CONFIG_USB_GADGET_DOWNLOAD=y
# CONFIG_WDT_SUNXI is not set
CONFIG_RSA=y
# CONFIG_TOOLS_LIBCRYPTO is not set
CONFIG_AW_PINCTRL_V3=y
CONFIG_AW_GPIO=y
CONFIG_AW_GPIO_V3=y
CONFIG_AW_DMA=y
CONFIG_AW_DMA_NO_RESET=y
CONFIG_AW_TWI=y
CONFIG_AW_SPI=y
CONFIG_AW_PWM=y
CONFIG_AW_USB=y
CONFIG_AW_EFEX=y
CONFIG_AW_BURN=y
CONFIG_AW_FASTBOOT=y
CONFIG_AW_UDC=y
CONFIG_AW_UDC_CONTROLLER=y
CONFIG_AW_USB_PHY=y
CONFIG_USB_EHCI_HCD_SUNXI=y
CONFIG_AW_DRM=y
CONFIG_AW_DRM_LVDS=y
CONFIG_AW_DRM_RGB=y
CONFIG_AW_DRM_DSI=y
# CONFIG_AW_DRM_HDMI_TX is not set
# CONFIG_AW_DRM_EINK200 is not set
CONFIG_AW_DRM_PANEL=y
CONFIG_PANEL_DSI_GENERAL=y
CONFIG_PANEL_LVDS_GENERAL=y
CONFIG_PANEL_RGB_GENERAL=y
CONFIG_AW_DRM_PHY=y
CONFIG_AW_CE_DRIVER=y
CONFIG_SUNXI_CE_23=y
CONFIG_AW_EFUSE=y
CONFIG_AW_NAND=y
CONFIG_SPI_SAMP_DL_EN=y
CONFIG_AW_MTD_SPINAND=y
CONFIG_AW_SPINAND_PSTORE_MTD_PART=y
CONFIG_AW_MTD_SPINAND_UBOOT_BLKS=40
CONFIG_AW_SPINOR=y
CONFIG_SPINOR_LOGICAL_OFFSET=3040
CONFIG_SUNXI_GPADC=y
CONFIG_SOUND_SUNXI_SUN8IW22_CODEC=y
CONFIG_AW_REMOTEPROC=y
CONFIG_BOOT_RISCV=y
CONFIG_AW_AMP_SYS_RSC_MANAGER=y
CONFIG_ASRM_RUN_ON_UBOOT=y
CONFIG_AW_GPIO_ISOLATION_DRIVER=y
CONFIG_AW_DMA_ISOLATION_DRIVER=y
CONFIG_CMD_SUNXI_TIMER=y
CONFIG_CMD_SUNXI_PRIVATE_STORAGE=y
CONFIG_CMD_SUNXI_EFEX=y
CONFIG_CMD_SUNXI_BURN=y
CONFIG_CMD_SUNXI_FASTBOOT=y
CONFIG_CMD_SUNXI_SOUND=y
CONFIG_CMD_SUNXI_SPRITE=y
CONFIG_SUNXI_REDUNDAND_ENVIRONMENT=y
CONFIG_CRYPTO=y
CONFIG_SYS_TEXT_BASE=0x43500000
CONFIG_SUNXI_KEYBOX=y
CONFIG_SUNXI_VERIFY_BOOT_EMBED_SIGN=y
CONFIG_SUNXI_EXTERN_SECURE_MM_LAYOUT=y
CONFIG_SUNXI_BOOT_PARAM=y
CONFIG_SUNXI_SERIAL=y
CONFIG_SUNXI_MAC=y
CONFIG_SUNXI_USER_KEY=y
CONFIG_SUNXI_VERIFY_RISCV=y
CONFIG_SUNXI_IMAGE_HEADER=y
# CONFIG_LOGF_MODULE is not set
# CONFIG_LOGF_LEVEL is not set
# CONFIG_LOGF_DEVNAME is not set
CONFIG_SUNXI_BOOT_ENV_INLINE=y
CONFIG_SUNXI_BOOT_ENV_STRING="preboot=sunxi_get_kern_env;sunxi_preboot\n bootcmd=run boot_riscv sunxi_pre_cmd boot_normal\n sunxi_pre_cmd=${sunxicmd};sunxi_update\n sunxicmd=run setargs_nand\n boot_normal=sunxi_flash read 0x40007800 ${boot_partition};bootm 0x40007800 ${sunxi_ramd_addr} ${sunxi_fdt_addr}\n boot_riscv=bootrv ${rv_fw_load_addr} ${rv_fw_load_size} 0 ${riscv_partition} ${riscv-r_partition}\n boot_recovery=\n boot_fastboot=fastboot\n altbootcmd=sunxi_switch_system\n"
CONFIG_SUNXI_ANDROID_OVERLAY=y
CONFIG_SUNXI_SMCCC_PERIPH_ACCESS=y
```

## sunxi-uboot-src/u-boot-2023/bsp/drivers/amp_rsc/Kconfig
```kconfig
# SPDX-License-Identifier: GPL-2.0-or-later
menu "Resource Isolation Driver"

config AW_AMP_SYS_RSC_MANAGER
	bool "Enable Allwinner AMP System Resourece Manager(ASRM)"
	default n

if AW_AMP_SYS_RSC_MANAGER
choice
	prompt "ASRM Run Environment"
	default ASRM_RUN_ON_LINUX_KERNEL

config ASRM_RUN_ON_UBOOT
	bool "Run On U-boot"
	select ASRM_DEFAULT_SELECT_ON_UBOOT

config ASRM_RUN_ON_RTOS
	bool "Run On RTOS"
	select ASRM_DEFAULT_SELECT_ON_RTOS

config ASRM_RUN_ON_LINUX_KERNEL
	bool "Run On Linux Kernel"
	select ASRM_DEFAULT_SELECT_ON_LINUX_KERNEL

endchoice

config AW_CURRENT_AMP_SYS_RSC_USER_ID
	int "Current AMP system resource user id in ASRM"
	default 0
	help
	  Current AMP system resource user id, depend on specific platform.
	  You can find all available user id in lowlevel/platform/platform_rsc_user_id.h.

config AW_GPIO_ISOLATION_DRIVER
	bool "Enable GPIO Isolation Driver"
	default n

if ASRM_RUN_ON_UBOOT
config ASRM_DEFAULT_SELECT_ON_UBOOT
	bool
	select AW_RPROC_RSC_HELPER
	select AW_RPROC_USER_RESOURCE

config AW_DMA_ISOLATION_DRIVER
	bool "Enable DMA Isolation Driver"
	default n

endif # if ASRM_RUN_ON_UBOOT

if ASRM_RUN_ON_LINUX_KERNEL
config ASRM_DEFAULT_SELECT_ON_LINUX_KERNEL
	bool
	select AW_RPROC_SUBDEV
	select AW_RPROC_SUBDEV_RSC_HELPER
	select AW_RPROC_USER_RESOURCE

config AW_ASRM_PROVIDE_PERI_CLK_INFO
	bool "ASRM provide peripheral clock info for CCU driver"
	default y

endif # if ASRM_RUN_ON_LINUX_KERNEL

if ASRM_RUN_ON_RTOS
config ASRM_DEFAULT_SELECT_ON_RTOS
	bool
	select COMPONENTS_AMP_USER_RESOURCE
	select AMP_USER_RESOURCE_3

config AW_AMP_SYS_RSC_MANAGER_TEST
	bool "ASRM test command"
	default n

endif # if ASRM_RUN_ON_RTOS

endif # if AW_AMP_SYS_RSC_MANAGER
endmenu
```

## sunxi-uboot-src/u-boot-2023/bsp/drivers/dma/Kconfig
```kconfig
config AW_DMA
         bool "SUNXI DMA driver"
         help
           Support for SUNXI DMA controller.
config AW_DMA_NO_RESET
         bool "SUNXI DMA driver clock not reset"
         depends on AW_DMA
         default n
         help
           This will not reset the clock
```

## sunxi-uboot-src/u-boot-2023/bsp/drivers/mmc/Kconfig
```kconfig
config AW_MMC
	bool "Allwinner sunxi SD/MMC Host Controller support"
	depends on ARCH_SUNXI && MMC
	default y
	help
	  This selects support for the SD/MMC Host Controller on
	  Allwinner sunxi SoCs.

if AW_MMC
config SUNXI_SDMMC_LOGICAL_OFFSET
	int "logic address for read/write"
	default 40960
	help
	  logic address for mbr and partitions(1M-MBRSIZE = 2048-32).
	  SDMMC address is offset*512 bytes.

config SUNXI_SDMMC_BOOT0_START_ADDR
	int "boot0 offset"
	default 16
	help
	  offset to write boot0, unit:sector(512 bytes)

config SUNXI_SDMMC_BOOT0_BACKUP_START_ADDR
	int "backup boot0 offset"
	default 256
	help
	  offset to write backup boot0, unit:sector(512 bytes)

config SUNXI_SDMMC_UBOOT_START_ADDR
	int "uboot offset"
	default 32800
	help
	  offset to write backup uboot, unit:sector(512 bytes)

config SUNXI_SDMMC_UBOOT_BACKUP_START_ADDR
	int "backup uboot offset"
	default 24576
	help
	  offset to write backup uboot, unit:sector(512 bytes)


endif
```

## sunxi-uboot-src/u-boot-2023/bsp/drivers/mtd/Kconfig
```kconfig
menu "AW-NAND Support"

config AW_NAND
	bool "SUNXI awnand driver"
	default n
	help
	  Support SUNXI awnand driver.

if AW_NAND
source "bsp/drivers/mtd/awnand/Kconfig"
endif

endmenu

menu "AW-SPINOR Support"

config AW_SPINOR
	bool "Support sunxi spinor devices"
	depends on (AW_SPI || AW_SPIF)
	select USE_SYS_MAX_FLASH_BANKS
	help
	  Enable support for sunxi spinor devices. These provide a block-level interface
	  which permits reading, writing and (in some cases) erasing blocks.

if AW_SPINOR
config SPINOR_UBOOT_OFFSET
	int "uboot offset for boot from spinor"
	default 128
	help
	 spinor address is offset*512 bytes.

config SPINOR_LOGICAL_OFFSET
	int "logic address for read/write"
	default 2016
	help
	  logic address for mbr and partitions(1M-MBRSIZE = 2048-32).
	  spinor address is offset*512 bytes.

config SPINOR_UBOOT_SECURE_OFFSET
	int "secure uboot offset for boot from spinor"
	default 128
	help
	 spinor address is offset*512 bytes.

config SPINOR_LOGICAL_SECURE_OFFSET
	int "secure logic address for read/write"
	default 2016
	help
	  logic address for mbr and partitions(1M-MBRSIZE = 2048-32).
	  spinor address is offset*512 bytes.

source "bsp/drivers/mtd/spi/Kconfig"
endif

endmenu

config SPI_SAMP_DL_EN
	bool "SPI try sample param"
	default n
	help
		support SPI try sample param
```

## sunxi-uboot-src/u-boot-2023/bsp/drivers/pcie/Kconfig
```kconfig
# SPDX-License-Identifier: GPL-2.0
#
# PCI Endpoint Support
#

config PCIE_ALLWINNER_EP
	bool "Allwinner PCIe endpoint controller"
	default n
	depends on PCI_ENDPOINT
	help
	  Say Y here if you want to support the Allwinner PCIe controller in
	  endpoint mode. This PCIe controller may be embedded into many
	  different vendors SoCs.

config PCIE_ALLWINNER_RC
	bool "Allwinner PCIe RC controller"
	depends on ARCH_SUNXI
	help
	   Enables support for the PCIe RC controller in the Allwinner SoC.
```

## sunxi-uboot-src/u-boot-2023/bsp/drivers/power/Kconfig
```kconfig
menuconfig AW_POWER
	bool "Sunxi power device support"

config AW_DM_PMIC
	bool "Enable Driver Model for PMIC drivers (UCLASS_PMIC)"
	depends on DM && AW_BSP && AW_POWER
	---help---
	This config enables the driver-model PMIC support.
	UCLASS_PMIC - designed to provide an I/O interface for PMIC devices.
	For the multi-function PMIC devices, this can be used as parent I/O
	device for each IC's interface. Then, each children uses its parent
	for read/write. For detailed description, please refer to the files:
	- 'drivers/power/pmic/pmic-uclass.c'
	- 'include/power/pmic.h'

config AW_PMIC_CHILDREN
	bool "Allow child devices for PMICs"
	depends on AW_DM_PMIC
	default y
	---help---
	This allows PMICs to support child devices (such as regulators) in
	SPL. This adds quite a bit of code so if you are not using this
	feature you can turn it off. Most likely you should turn it on for
	U-Boot proper.

config AW_PMIC_AXP
	bool "Enable Driver Model for X-Powers AXP PMICs"
	depends on DM_I2C && AW_DM_PMIC
	select SYSRESET_CMD_POWEROFF if SYSRESET && CMD_POWEROFF
	imply CMD_POWEROFF if SYSRESET
	help
	  This config enables driver-model PMIC uclass features for
	  X-Powers AXP152, AXP2xx, and AXP8xx PMICs.

config AW_REGULATOR_AXP
	bool "Enable driver for X-Powers AXP PMIC regulators"
	depends on AW_PMIC_AXP && DM_REGULATOR
	help
	  Enable support for the regulators (DCDCs, LDOs) in the
	  X-Powers AXP152, AXP2xx, and AXP8xx PMICs.

config AW_DM_SUPPLY
	bool "Enable Driver Model for SUPPLY drivers (UCLASS_SUPPLY)"
	depends on DM && AW_BSP && AW_POWER
	---help---
	This config enables the driver model regulator support.
	UCLASS_SUPPLY - designed to provide a common API for basic regulator's
	functions, like get/set Voltage or Current value, enable state, etc...
	Note:
	When enabling this, please read the description, found in the files:
	- 'include/power/pmic.h'
	- 'include/power/regulator.h'
	- 'drivers/power/pmic/pmic-uclass.c'
	- 'drivers/power/pmic/regulator-uclass.c'
	It's important to call the device_bind() with the proper node offset,
	when binding the regulator devices. The pmic_bind_childs() can be used
	for this purpose if PMIC I/O driver is implemented or dm_scan_fdt_dev()
	otherwise. Detailed information can be found in the header file.

config AW_SUPPLY_AXP517
	bool "Enable driver for X-Powers AXP PMIC supply"
	depends on AW_PMIC_AXP && AW_DM_SUPPLY
	help
	  Enable support for the supply in the X-Powers PMICs.
```

## sunxi-uboot-src/u-boot-2023/bsp/drivers/pwm/Kconfig
```kconfig
config AW_PWM
	bool "Enable support for the Allwinner Sunxi PWM"
	depends on DM_PWM
	help
	  This PWM is found on H3, A64 and other Allwinner SoCs. It supports a
	  programmable period and duty cycle. A 16-bit counter is used.

config AW_PWMCS
	bool "Enable support for the Allwinner Sunxi PWMCS"
	depends on DM_PWM
	help
	  This PWMCS is found on Allwinner SoCs. It supports a programmable
	  period and duty cycle. A 16-bit counter is used.
```

## sunxi-uboot-src/u-boot-2023/bsp/drivers/remoteproc/Kconfig
```kconfig
config AW_REMOTEPROC
	bool "SUNXI remoteproc driver"
	depends on DM
	select REMOTEPROC
	default n
	help
	  Support for SUNXI remoteproc.

if AW_REMOTEPROC

config AW_RPROC_MISC_OPS
	depends on AW_REMOTEPROC
	bool "Sunxi remoteproc misc ops support"

config AW_RPROC_RSC_HELPER
	depends on AW_REMOTEPROC
	bool "Sunxi remoteproc rsc helper support"

config AW_RPROC_USER_RESOURCE
	select AW_RPROC_MISC_OPS
	depends on AW_RPROC_RSC_HELPER
	bool "Sunxi remoteproc user resource handle support"

config AW_RPROC_BOOT_REASON
	depends on AW_REMOTEPROC
	bool "Sunxi remoteproc boot reason support"

config BOOT_RISCV
	bool "Support RISCV"
	default n

config RISCV_UPDATA_IRQ_TAB
	bool "Support RISCV share irq table updata"
	depends on BOOT_RISCV
	default n

config RISCV_UPDATA_IRQ_TAB_DEBUG
	bool "Support RISCV share irq table updata debug log"
	depends on RISCV_UPDATA_IRQ_TAB
	default n

config AW_VF_FOR_T536
	bool "Select vf table for t536 plarform"
	default n
endif
```

## sunxi-uboot-src/u-boot-2023/bsp/drivers/spi/Kconfig
```kconfig
config AW_SPI
	bool "SUNXI SPI driver"
	depends on SPI
	default n
	select HEXDUMP
	help
	  Support for SUNXI SPI controller.

config AW_SPIF
	bool "SUNXI SPIF driver"
	depends on SPI
	default n
	select HEXDUMP
	help
	  Support for SUNXI SPI FLASH controller.
```
