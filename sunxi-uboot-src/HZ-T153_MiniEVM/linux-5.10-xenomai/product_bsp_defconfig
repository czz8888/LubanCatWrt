## sunxi-uboot-src/HZ-T153_MiniEVM/linux-5.10-xenomai/product_bsp_defconfig
```kconfig
CONFIG_AW_BSP=y
CONFIG_AW_KERNEL_ORIGIN=y
CONFIG_ARCH_SUN8IW22=y
CONFIG_AW_IC_BOARD=y
CONFIG_AW_SOC_NAME="T153"
# CONFIG_AW_DDR_CCU is not set
# CONFIG_AW_UART is not set
CONFIG_AW_UART_NG=y
CONFIG_AW_SERIAL_CONSOLE=y
CONFIG_AW_TIMER_SUN50I=y
CONFIG_AW_DMA=y
CONFIG_AW_RTC=y
CONFIG_AW_RTC_REBOOT_FLAG=y
CONFIG_AW_RTC_POWEROFF_ALARM=y
# CONFIG_AW_DDRECC is not set
CONFIG_AW_WATCHDOG=y
CONFIG_AW_MBUS_GENERIC=y
CONFIG_AW_MTD=y
CONFIG_AW_MTD_SPINAND=y
CONFIG_SUNXI_BOOT_PARAM=y
CONFIG_AW_G2D=y
CONFIG_G2D200=y
CONFIG_AW_DRM=y
CONFIG_AW_DRM_LVDS=y
CONFIG_AW_DRM_RGB=y
CONFIG_AW_DRM_DSI=y
CONFIG_PANEL_DSI_GENERAL=y
CONFIG_PANEL_LVDS_GENERAL=y
CONFIG_PANEL_RGB_GENERAL=y
CONFIG_AW_DRM_PHY=y
CONFIG_AW_DRM_DSI_COMBOPHY=y
# CONFIG_AW_VIDEO_ENCODER_DECODER is not set
CONFIG_SND_SOC_SUNXI_AAUDIO=y
CONFIG_SND_SOC_SUNXI_OWA=y
CONFIG_SND_SOC_SUNXI_DMIC=y
CONFIG_SND_SOC_SUNXI_I2S=y
CONFIG_SND_SOC_SUNXI_COMPONENTS=y
CONFIG_SND_SOC_SUNXI_SFX=y
CONFIG_AW_SYS_INFO=y
CONFIG_AW_SMC=y
CONFIG_AW_STMMAC_ETH=y
CONFIG_AW_STMMAC_SELFTESTS=y
CONFIG_USB_EHCI_HCD_SUNXI=y
CONFIG_USB_OHCI_HCD_SUNXI=y
CONFIG_USB_SUNXI_HCD=y
CONFIG_USB_SUNXI_HCI=y
CONFIG_USB_SUNXI_EHCI0=y
CONFIG_USB_SUNXI_EHCI1=y
CONFIG_USB_SUNXI_OHCI0=y
CONFIG_USB_SUNXI_OHCI1=y
CONFIG_USB_SUNXI_USB=y
CONFIG_USB_SUNXI_USB_MANAGER=y
CONFIG_USB_SUNXI_USB_ADB=y
CONFIG_USB_SUNXI_UDC0=y
CONFIG_USB_SUNXI_PHY=y
CONFIG_USB_SUNXI_AWPHY=y
CONFIG_AW_TWI=y
CONFIG_AW_SPI_NG=y
CONFIG_AW_PWM=y
# CONFIG_AW_PWM_DYNAMIC_DEBUG is not set
CONFIG_AW_PWMCS=y
CONFIG_AW_GPADC=y
# CONFIG_AW_GPADC_DYNAMIC_DEBUG is not set
CONFIG_AW_RTP=y
# CONFIG_AW_TPADC_DYNAMIC_DEBUG is not set
CONFIG_AW_INPUT_CTP=y
CONFIG_TOUCHSCREEN_GT9XX=y
CONFIG_AW_MOTORCOMM_PHY=y
CONFIG_AW_WAKEUPGEN=y
CONFIG_AW_THERMAL=y
CONFIG_NVMEM_AW_SID=y
CONFIG_AW_REGULATOR_PWM=y
CONFIG_AW_CPUFREQ_DT=y
CONFIG_ARM_AW_SUN50I_CPUFREQ_NVMEM=y
# CONFIG_AW_NNA_VIP is not set
# CONFIG_AW_NNA_GALCORE is not set
# CONFIG_LOCALVERSION_AUTO is not set
# CONFIG_SWAP is not set
CONFIG_NO_HZ=y
CONFIG_HIGH_RES_TIMERS=y
CONFIG_PREEMPT_RT=y
CONFIG_IKCONFIG=y
CONFIG_IKCONFIG_PROC=y
CONFIG_CGROUPS=y
CONFIG_NAMESPACES=y
# CONFIG_UTS_NS is not set
# CONFIG_PID_NS is not set
CONFIG_EXPERT=y
# CONFIG_SYSFS_SYSCALL is not set
# CONFIG_FHANDLE is not set
# CONFIG_AIO is not set
# CONFIG_IO_URING is not set
CONFIG_KALLSYMS_ALL=y
# CONFIG_RSEQ is not set
# CONFIG_PERF_EVENTS is not set
# CONFIG_SLUB_DEBUG is not set
# CONFIG_COMPAT_BRK is not set
# CONFIG_SLAB_MERGE_DEFAULT is not set
CONFIG_PROFILING=y
# CONFIG_MACH_SUN4I is not set
# CONFIG_MACH_SUN5I is not set
# CONFIG_MACH_SUN6I is not set
# CONFIG_MACH_SUN7I is not set
# CONFIG_MACH_SUN9I is not set
CONFIG_SMP=y
CONFIG_HAVE_ARM_ARCH_TIMER=y
CONFIG_ARM_PSCI=y
CONFIG_OABI_COMPAT=y
CONFIG_CPU_FREQ=y
CONFIG_CPU_FREQ_GOV_POWERSAVE=y
CONFIG_CPU_FREQ_GOV_USERSPACE=y
CONFIG_CPU_FREQ_GOV_ONDEMAND=y
CONFIG_CPU_FREQ_GOV_CONSERVATIVE=y
CONFIG_CPU_IDLE=y
CONFIG_ARM_PSCI_CPUIDLE=y
CONFIG_VFP=y
CONFIG_NEON=y
CONFIG_KERNEL_MODE_NEON=y
CONFIG_PM_WAKELOCKS=y
CONFIG_PM_DEBUG=y
CONFIG_PM_ADVANCED_DEBUG=y
CONFIG_ENERGY_MODEL=y
CONFIG_MODULES=y
CONFIG_MODULE_UNLOAD=y
# CONFIG_CORE_DUMP_DEFAULT_ELF_HEADERS is not set
CONFIG_CMA=y
CONFIG_NET=y
CONFIG_PACKET=y
CONFIG_UNIX=y
CONFIG_UNIX_DIAG=y
CONFIG_NET_KEY=y
CONFIG_INET=y
CONFIG_IP_MULTICAST=y
CONFIG_IP_ADVANCED_ROUTER=y
CONFIG_IP_FIB_TRIE_STATS=y
CONFIG_IP_MULTIPLE_TABLES=y
CONFIG_INET_IPCOMP=y
CONFIG_INET_UDP_DIAG=y
CONFIG_DEVTMPFS=y
# CONFIG_ALLOW_DEV_COREDUMP is not set
# CONFIG_SUNXI_RSB is not set
# CONFIG_BLK_DEV is not set
CONFIG_SCSI=y
CONFIG_BLK_DEV_SD=y
CONFIG_SCSI_DEBUG=y
# CONFIG_NET_VENDOR_ALACRITECH is not set
# CONFIG_NET_VENDOR_ALLWINNER is not set
# CONFIG_NET_VENDOR_AMAZON is not set
# CONFIG_NET_VENDOR_AQUANTIA is not set
# CONFIG_NET_VENDOR_ARC is not set
# CONFIG_NET_VENDOR_BROADCOM is not set
# CONFIG_NET_VENDOR_CADENCE is not set
# CONFIG_NET_VENDOR_CAVIUM is not set
# CONFIG_NET_VENDOR_CIRRUS is not set
# CONFIG_NET_VENDOR_CORTINA is not set
# CONFIG_NET_VENDOR_EZCHIP is not set
# CONFIG_NET_VENDOR_FARADAY is not set
# CONFIG_NET_VENDOR_GOOGLE is not set
# CONFIG_NET_VENDOR_HISILICON is not set
# CONFIG_NET_VENDOR_HUAWEI is not set
# CONFIG_NET_VENDOR_INTEL is not set
# CONFIG_NET_VENDOR_MARVELL is not set
# CONFIG_NET_VENDOR_MICREL is not set
# CONFIG_NET_VENDOR_MICROCHIP is not set
# CONFIG_NET_VENDOR_MICROSEMI is not set
# CONFIG_NET_VENDOR_NATSEMI is not set
# CONFIG_NET_VENDOR_NETRONOME is not set
# CONFIG_NET_VENDOR_NI is not set
# CONFIG_NET_VENDOR_PENSANDO is not set
# CONFIG_NET_VENDOR_QUALCOMM is not set
# CONFIG_NET_VENDOR_RENESAS is not set
# CONFIG_NET_VENDOR_ROCKER is not set
# CONFIG_NET_VENDOR_SAMSUNG is not set
# CONFIG_NET_VENDOR_SEEQ is not set
# CONFIG_NET_VENDOR_SOLARFLARE is not set
# CONFIG_NET_VENDOR_SMSC is not set
# CONFIG_NET_VENDOR_SOCIONEXT is not set
# CONFIG_DWMAC_GENERIC is not set
# CONFIG_DWMAC_SUNXI is not set
# CONFIG_DWMAC_SUN8I is not set
# CONFIG_NET_VENDOR_SYNOPSYS is not set
# CONFIG_NET_VENDOR_VIA is not set
# CONFIG_NET_VENDOR_WIZNET is not set
# CONFIG_NET_VENDOR_XILINX is not set
CONFIG_REALTEK_PHY=y
# CONFIG_WLAN is not set
# CONFIG_SERIO_SERPORT is not set
# CONFIG_VT is not set
# CONFIG_LEGACY_PTYS is not set
CONFIG_SERIAL_8250=y
# CONFIG_SERIAL_8250_DEPRECATED_OPTIONS is not set
CONFIG_SERIAL_8250_CONSOLE=y
CONFIG_SERIAL_8250_RUNTIME_UARTS=0
CONFIG_SERIAL_8250_DW=y
CONFIG_SERIAL_OF_PLATFORM=y
# CONFIG_HW_RANDOM is not set
# CONFIG_DEVMEM is not set
# CONFIG_PINCTRL_SUN4I_A10 is not set
# CONFIG_PINCTRL_SUN8I_A23 is not set
# CONFIG_PINCTRL_SUN8I_A33 is not set
# CONFIG_PINCTRL_SUN8I_A83T is not set
# CONFIG_PINCTRL_SUN8I_A83T_R is not set
# CONFIG_PINCTRL_SUN8I_A23_R is not set
# CONFIG_PINCTRL_SUN8I_H3 is not set
# CONFIG_PINCTRL_SUN8I_H3_R is not set
# CONFIG_PINCTRL_SUN8I_V3S is not set
CONFIG_POWER_SUPPLY=y
CONFIG_THERMAL_STATISTICS=y
CONFIG_THERMAL_WRITABLE_TRIPS=y
CONFIG_THERMAL_DEFAULT_GOV_POWER_ALLOCATOR=y
CONFIG_THERMAL_GOV_FAIR_SHARE=y
CONFIG_THERMAL_GOV_STEP_WISE=y
CONFIG_THERMAL_GOV_BANG_BANG=y
CONFIG_THERMAL_GOV_USER_SPACE=y
CONFIG_THERMAL_GOV_POWER_ALLOCATOR=y
CONFIG_CPU_THERMAL=y
CONFIG_THERMAL_EMULATION=y
CONFIG_REGULATOR=y
CONFIG_REGULATOR_FIXED_VOLTAGE=y
# CONFIG_MEDIA_CEC_SUPPORT is not set
CONFIG_MEDIA_SUPPORT=y
CONFIG_DRM=y
CONFIG_SOUND=y
CONFIG_SND=y
CONFIG_SND_SOC=y
CONFIG_USB=y
CONFIG_USB_ANNOUNCE_NEW_DEVICES=y
CONFIG_USB_EHCI_HCD=y
CONFIG_USB_EHCI_ROOT_HUB_TT=y
CONFIG_USB_OHCI_HCD=y
CONFIG_USB_STORAGE=y
CONFIG_USB_STORAGE_REALTEK=y
CONFIG_USB_STORAGE_DATAFAB=y
CONFIG_USB_STORAGE_FREECOM=y
CONFIG_USB_STORAGE_ISD200=y
CONFIG_USB_STORAGE_USBAT=y
CONFIG_USB_STORAGE_SDDR09=y
CONFIG_USB_STORAGE_SDDR55=y
CONFIG_USB_STORAGE_JUMPSHOT=y
CONFIG_USB_STORAGE_ALAUDA=y
CONFIG_USB_STORAGE_ONETOUCH=y
CONFIG_USB_STORAGE_KARMA=y
CONFIG_USB_STORAGE_CYPRESS_ATACB=y
CONFIG_USB_STORAGE_ENE_UB6250=y
CONFIG_USB_UAS=y
CONFIG_USB_GADGET=y
CONFIG_USB_CONFIGFS=y
CONFIG_USB_CONFIGFS_MASS_STORAGE=y
CONFIG_USB_CONFIGFS_F_FS=y
CONFIG_USB_ROLE_SWITCH=y
# CONFIG_RTC_DRV_SUN6I is not set
CONFIG_DMABUF_HEAPS=y
CONFIG_DMABUF_HEAPS_SYSTEM=y
CONFIG_DMABUF_HEAPS_CMA=y
# CONFIG_SUNXI_CCU is not set
# CONFIG_ARM_ARCH_TIMER_EVTSTREAM is not set
# CONFIG_IOMMU_SUPPORT is not set
CONFIG_IIO=y
CONFIG_TEE=y
CONFIG_OPTEE=y
# CONFIG_DNOTIFY is not set
CONFIG_TMPFS=y
CONFIG_UBIFS_FS=y
CONFIG_NLS_CODEPAGE_437=y
CONFIG_XZ_DEC=y
CONFIG_DMA_CMA=y
CONFIG_PRINTK_TIME=y
CONFIG_MESSAGE_LOGLEVEL_DEFAULT=7
# CONFIG_SECTION_MISMATCH_WARN_ONLY is not set
CONFIG_MAGIC_SYSRQ=y
# CONFIG_DEBUG_MISC is not set
CONFIG_PANIC_ON_OOPS=y
# CONFIG_SCHED_DEBUG is not set
CONFIG_STACKTRACE=y
# CONFIG_FTRACE is not set
```

## sunxi-uboot-src/u-boot-2023/bsp/board/sunxi/Kconfig
```kconfig
choice
	prompt "SPL Image Type"
	default SPL_IMAGE_TYPE_SUNXI_EGON

config SPL_IMAGE_TYPE_SUNXI_EGON
	bool "eGON (normal)"
	help
	  Select this option to embed the SPL binary in an eGON.BT0 image,
	  which is compatible with the normal boot ROM (NBROM).

	  This is usually the correct option to choose.

config SPL_IMAGE_TYPE_SUNXI_TOC0
	bool "TOC0 (secure)"
	help
	  Select this option to embed the SPL binary in a TOC0 image,
	  which is compatible with the secure boot ROM (SBROM).

endchoice

choice
	prompt "rotpk burn on sprite"
	default SUNXI_NOT_BURN_ROTPK

config SUNXI_NOT_BURN_ROTPK
	bool "do not burn"

config SUNXI_BURN_ROTPK_ON_SPRITE
	bool "always burn"
	help
		Burn rotpk before set secure bit to 1

config SUNXI_ROTPK_BURN_ENABLE_BY_TOOL
	bool "tool enable"
	help
		if tool do not specific, do not burn

endchoice

config SUNXI_DTB_OFFSET
	bool "use separate dtb"
	default n
	---help---
	  dtb offset is 2M to uboot

config SUNXI_RECOVER_BACKBOOT
	bool "recover back boot"
	default n
	---help---
	  recover back boot when booting

config SPL_IMAGE_TYPE
	string
	default "sunxi_egon" if SPL_IMAGE_TYPE_SUNXI_EGON
	default "sunxi_toc0" if SPL_IMAGE_TYPE_SUNXI_TOC0

config SYS_TEXT_BASE
	default 0x43000000 if ARCH_SUNXI
	hex "Text Base"
	help
	  The address in memory that U-Boot will be running from, initially.

config SUNXI_NOR_IMG
	bool "crate u-boot-nor.bin"
	default false

menu "OPTEE_VERSION"

choice
	prompt "select optee version"
	default OPTEE25 if MACH_SUN8IW18

config OPTEE25
	bool "use optee 2.5 smc api"
	---help---
	Select this to use optee 2.5 smc api.

config NOT_USE_OPTEE25
	bool "no use optee 2.5 smc api"
	---help---
	Select this to no use optee 2.5 smc api.
endchoice

endmenu

config SUNXI_PRIVATE_STORAGE
	bool "Sunxi Sprite Private Storage"
	help
	  Enable supprot for sunxi private storage

config SUNXI_KEYBOX
	bool "Sunxi Keybox Private Storage"
	help
	  Enable supprot for sunxi keybox private storage

config SUNXI_IMAGE_VERIFIER
	bool "Sunxi image verify support"
	default n
	select SUNXI_CE_DRIVER
	select OPENSSL

if SUNXI_IMAGE_VERIFIER
	config SUNXI_VERIFY_BOOT_EMBED_SIGN
	bool "Sunxi only verify boot.img embed signature"
	default n
endif

if SUNXI_KEYBOX
config SECURE_STORAGE_KEY_HUK
	bool "Keybox Crypto by HUK"
	default y
	help
	  Enable sunxi keybox crypto by huk
endif

config SUNXI_EXTERN_SECURE_MM_LAYOUT
	bool "sunxi secure memory lay defined in fdt"
	default n
	help
		when enable, uboot try to load secure memory layout
		from fdt(shm\ta ram). Notify secure os configurated
		layout and mard those memory as "reserved memory" in
		fdt

config SUNXI_EFEX_IMG
	bool "crate u-boot-efex.bin"
	default false

config LAST_PARTITION_NAME
    string "set last partition name"
    default "UDISK"
    help
      Last partition name.

config SUNXI_BOOT_PARAM
	bool "enable sunxi boot param"
	help
		store startup related parameters

config SUNXI_FDT_ADDR
	hex "device tree address for kernel"
	default 0
	---help---
	set the address for start_kernel.

config SUNXI_FDT_MALLOC_SIZE
	hex "device tree size for kernel"
	default 0x40000
	---help---
	set the size for start_kernel.

config AW_BSP
	bool "Allwinner Platform"
	default y
	select PINCTRL
	help
		This enables support for Allwinner sunxi based SoCs like the A64.

config SUNXI_SERIAL
	bool "Update snum to bootargs"
	depends on AW_EFUSE
	default n

config SUNXI_MAC
	bool "sunxi_mac"
	default n
	help
		when enabled, uboot read mac addr and send to system via cmdline

config SUNXI_USER_KEY
	bool "user key"
	default n
	select SUNXI_PRIVATE_STORAGE
	select CMD_FAT
	help
		when enable, uboot try to read cmdline data from secure storage

config SUNXI_SET_EFUSE_POWER
	bool "set sunxi efuse power"
	default n
	help
		Efuse is powered by the pmu.

config SUNXI_ENABLE_FEL_VERIFY
	bool "enable sunxi sign fel verify"
	default n
	help
		Burn efuse sign fel bit

config SUNXI_LOG
	bool "Sunxi out put log with timestamp"
	depends on LOG
	default y

config AW_STACKTRACE
	bool "allwinner stacktrace"
	depends on ARM64 || ARM
	default n

config SUNXI_FPGA_PLATFORM
	bool "build for fpga platform"
	help
		fpga board have special treament for resources like
		clock or io, this config enable thoes special treament

config SUNXI_VERIFY_DSP
	bool "sunxi verify dsp"
	default n
	depends on XTENSA_DSP
	depends on SUNXI_SECURE_BOOT
	help
		when enable, uboot will verify the dsp bin.

config SUNXI_VERIFY_RISCV
	bool "sunxi verify riscv"
	default n
	depends on SUNXI_SECURE_BOOT
	help
		when enable, secure boot uboot will verify the riscv bin.

config SUNXI_VERIFY_RV
        bool "sunxi verify rv"
        default n
        depends on BOOT_RISCV
        help
                when enable, uboot will verify the rv0 & rv1.

config SUNXI_IMAGE_HEADER
	bool "sunxi verify with image header"
	default n
	help
		when enable, uboot will verify with image header.

config LOGF_TIME
	bool "Add time information before the output log"
	default y

config LOGF_MODULE
	bool "Add cat information before the output log"
	default y

config LOGF_LEVEL
	bool "Add level information before the output log"
	default y

config LOGF_DEVNAME
	bool "Add level information before the output log"
	default y

source "bsp/board/sunxi/sprite/Kconfig"

config SUNXI_BOOT_ENV_INLINE
	bool "sunxi boot env set in uboot"
	default n
	depends on ENV_IS_IN_SUNXI_FLASH
	help
		support set boot env in uboot, which will cover partition's env
if SUNXI_BOOT_ENV_INLINE
config SUNXI_BOOT_ENV_STRING
	string "default boot env"
	help
		This env string can not be changed by env partition.
endif

config SUNXI_ANDROID_OVERLAY
	bool "sunxi ANDROID fdt library overlay support"
	depends on OF_LIBFDT_OVERLAY
	default n
	help
		This enables the SUNXI ANDROID FDT library (libufdt) overlay support.

config SUNXI_SWITCH_SYSTEM
	bool "sunxi switch system"
	default n
	select BOOTCOUNT_LIMIT
	select BOOTCOUNT_ENV
	help
	    Supports automatic switching and damaged switching

config SUNXI_GPIO_BOOT
	bool "sunxi gpio boot"
	default n
	select CMD_GPIO
	select DM_GPIO
	help
	    Supports long press to boot
config SUNXI_ANDROID_BOOT
	bool "android boot sequence"
	default n
	help
		boot seqquence requested by AOSP.

config COMPONENTS_CERTIFICATION_60730
	bool "support IEC60730 certification"
	default n
	help
		support IEC60730 certification

config SUNXI_SMCCC_PERIPH_ACCESS
	bool "Support sunxi smccc periph access"
	depends on OPTEE25
	default n
	help
		Support sunxi smccc periph access

config SUNXI_DUAL_STORAGE
	bool "Support sunxi dual storage"
	depends on OF_LIBFDT
	default n
	help
	  Enable support for sunxi dual storage (e.g. SPI-Nor + eMMC,
	  this option enables booting BOOT0/U-Boot from SPI-Nor flash, and loading kernel/rootfs from eMMC.)
	  you also have to set two properties (boot_storage_type and system_storage_type) int U-boot dts.
```

## sunxi-uboot-src/u-boot-2023/bsp/board/sunxi/sprite/Kconfig
```kconfig
menuconfig SUNXI_SPRITE
    bool "Sunxi Sprite support"
    select AW_FLASH
    help
      Enable support for sunxi efex devices.

if SUNXI_SPRITE
config SUNXI_CARD_PRODUCT
	bool "Sunxi card product support"
	depends on AW_MMC
	default y
	help
	  Enable support for sunxi card product

config SUNXI_SPRITE_CARTOON
	bool "Sunxi Sprite cartoon support"
	select SUNXI_FLASH
	default n
	help
	  Enable support for sunxi Sprite cartoon(display)

config SUNXI_SPRITE_LED
	bool "Sunxi Sprite LED support"
	default y
	help
	  Enable support for sunxi Sprite LED(display)

config SUNXI_AUTO_UPDATE
	bool "Sunxi auto update support"
	depends on MMC || USB
	default n
	help
	  Enable support for sunxi auto update

if SUNXI_AUTO_UPDATE
config SUNXI_AUTO_UPDATE_CHECK
	bool "Sunxi auto update check"
	default n
	help
	  Enable support for sunxi auto update check by gpadc key
endif

config FW_BURN_UDISK_MIN_SIZE
	hex "UDISK min data length default is 0x800"
	depends on SUNXI_SPRITE || SUNXI_AUTO_UPDATE
	default 0x800
	help
	  set UDISK min data length

endif
```
